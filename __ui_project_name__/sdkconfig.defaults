## __ui_project_name__/sdkconfig.defaults
```kconfig
# SDK config defaults (to use delete exsisting sdkconfig file, when building or menuconfigis used a new sdconfig based on these defaults is generated)
# Config created for following hardware:
# Sunton ESP32-2432S028 LCD TFT 240x320 ILI9341V - ILITEK (LCD driver) and XPT2046 - XPT (resistive touch driver)

## ESP32
# Make the CPU RUN as fast as possible (more FPS)
CONFIG_ESP_DEFAULT_CPU_FREQ_MHZ_240=y
# Set correct flash size for the board
CONFIG_ESPTOOLPY_FLASHSIZE_4MB=y

## lvgl
CONFIG_LV_COLOR_16_SWAP=y

## lvgl_esp32_drivers
CONFIG_LV_PREDEFINED_DISPLAY_SUNTON_2432S028=y
```
